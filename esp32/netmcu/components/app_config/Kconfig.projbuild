## esp32/netmcu/components/app_config/Kconfig.projbuild
```kconfig
menu "RV Project Configuration"

   config STM32_UART_TX_PIN
        int "UART GPIO for TX to STM32 RX PA10"
        default 4

   config STM32_UART_RX_PIN
        int "UART GPIO for RX from STM32 TX PA9"
        default 36

   config STM32_RESET_PIN
        int "GPIO to Reset STM32"
        default 33

   config STM32_BOOT_PIN
        int "GPIO for boot mode (Firmware / Boatloader)"
        default 32
        
  config APP_USE_WEATHER_AUTO
        bool "Compile with weather data dependent auto irrigation"
        default n

   config APP_USE_HTTP_SERVE_JS_MAP
        depends on APP_USE_HTTP
        bool "Serve wapp.js.map file"
        default y

    config APP_USE_HTTP_SERVE_CSS_MAP
        depends on APP_USE_HTTP
        bool "Serve wapp.css.map file"
        default n

    config APP_USE_SERIAL
        bool "Activate SERIAL"
        default y

    config APP_USE_WDG
        bool "Activate WDG"
        default y

    config APP_USE_FS
        bool "Activate FS"
        default y

    config APP_USE_HTTP_CLIENT
        bool "Activate HTTP_CLIENT"
        default y


    config APP_USE_STM32OTA
        bool "Activate STM32OTA"
        default y

    config APP_USE_TCPS
        bool "Activate TCPS"
        default n

    config APP_USE_TCPS_TASK
        bool "Activate TCPS_TASK"
        default y

    config APP_USE_EG
        bool "Activate EG"
        default y

    config APP_USE_WS
        bool "Activate WS"
        default y

    config APP_USE_CLI_MUTEX
        bool "Activate CLI_MUTEX"
        default y

    config APP_USE_STM32COM
        bool "Activate STM32COM"
        default y

    config APP_USE_AP_FALLBACK
        bool "Activate AP_FALLBACK"
        default y





    config APP_USE_NETWORK
        bool "Compile NETWORK support"
        default y

    config APP_USE_LAN
        depends on APP_USE_NETWORK
        bool "Compile with LAN supprt"
        default y
        
     config APP_USE_WLAN
        depends on APP_USE_NETWORK
        bool "Compile with WLAN support"
        default y
        
    config APP_USE_HTTP
        depends on APP_USE_NETWORK
        bool "Compile HTTP server"
        default y

    config APP_USE_WS
        depends on APP_USE_HTTP
        bool "Compile with Websocket support"
        default y

    config APP_USE_MQTT
        depends on APP_USE_NETWORK
        bool "Compile MQTT client"
        default y

    config APP_MQTT_CLIENT_ID
        string
        default "Regner"

    config APP_MQTT_ROOT_TOPIC
        string
        default "rv"

    config APP_USE_OTA
        depends on APP_USE_NETWORK
        bool "Compile with over-the-air update support"
        default y

    config APP_USE_POSIX_TIME
        bool "Compile with Posix time support"
        default y

    config APP_USE_MUTEX
        bool "Compile with MUTEX support"
        default y
        help
            If disabled, use a dummy instead of a real Mutex
            Note: Disable it only for testing/debugging purposes

    config APP_USE_ESP_GET_TIME
        bool "Get up-time from esp_timer_get_time()"
        default y
        help
            Don't count up-time in our own timer-ISR.
            Use esp_timer_get_time() instead

    config APP_USE_GPIO_PINS
        bool "Compile with support for user defined GPIOs"
        default y
        help
            The user can define GPIOs from CLI/web-app, which then can be read or set via MQTT

    config APP_USE_FREERTOS
        bool "Compile FreeRTOS-dependent code in common modules"
        default y

    config APP_USE_LPH
        bool "Compile support for liter-per-hour"
        default y


    config APP_USE_EG
        bool "use EG?"
        default y

    config APP_GEO_TZ
        string "POSIX TZ string"
        default "CET-1CEST-2,M3.5.0,M10.5.0"

    config APP_SETTINGS_PASSWORD
        string "password for MCU settings"
        default ""

    config APP_WIFI_AP_SSID
        string "WIFI/WLAN access-point SSID"
        default "rv"

    config APP_WIFI_AP_PASSWORD
        string "WIFI/WLAN access-point password"
        default "12345678"

    config APP_CFG_NAMESPACE
        string "Namespace for kvs configuration storage"
        default "Tronferno"
        help
            Note: When changed, the previous configuration data will become inacessible

    config APP_GPIO_NUMBER_OF_GPIOS
        int "Number of available GPIOs"
        default 40
        help
            Number of GPIOs this MCU has (ESP32: 40)

    config MAIN_LOOP_PERIOD_MS
        int "main loop period in milliseconds"
        default 100
        help
            How frequently the main loop is called by timer

    config NETWORK_CHECK_LOOP_PERIOD_S
        int "network check loop period in seconds"
        default 15
        help
            How frequently the network connection is checked for appearing while disconnected

    config APP_USE_PROTOBUF
        bool "Compile Protobuf support"
        default y


endmenu
```

## esp32/netmcu/components/rv_netmcu/Kconfig
```kconfig
menu "zwiebert: rv_netmcu"
  config APP_PING_THE_GATEWAY
        bool "Check network connection by sending a ping to the gateway."
        default n
        help
           This no longer works. Leave it disabled.
           
  config APP_FA_NAMES_MAX_LEN
        int "Maximal length of names for valves, groups, etc in full automation"
        default 32

  config APP_NUMBER_OF_VALVES
        int "Number of possible valves this system can control"
        default 16

  config APP_FA_MAX_VALVE_GROUPS
        int "Max possible number of valve groups for full automatiion"
        default 16
              
  config APP_FA_MAX_WEATHER_ADAPTERS
        int "Max possible number of weather adapters for full automatiion"
        default 16
endmenu
```

## esp32/netmcu/sdkconfig.defaults
```kconfig
CONFIG_HTTPD_WS_SUPPORT=y
CONFIG_LWIP_MAX_SOCKETS=12
CONFIG_HTTPD_MAX_REQ_HDR_LEN=1024
CONFIG_HTTPD_MAX_URI_LEN=128
CONFIG_LWIP_SO_REUSE=y
CONFIG_LWIP_SO_REUSE_RXTOALL=y
```

## stm32/rv/Kconfig.projbuild
```kconfig
  rsource "src/main/Kconfig"
  rsource "external/mbed-uout/Kconfig"
  rsource "external/components-misc/components/txtio/Kconfig"
  rsource "external/components-misc/components/cli/Kconfig"
```

## stm32/rv/src/main/Kconfig
```kconfig
menu "RV"

rsource "water_pump/Kconfig"
  config USART_STDIN
    int "usart number for reading from stdin (fd 0)"
    default 1

  config USART_STDOUT
    int "usart number for writing to stdout (fd 1)"
    default 1

  config USART_STDERR
    int "usart number for writing to stderr (fd 2). set 0 to disable stderr"
    default 2
    
  config RV_USE_WATCHDOG
    bool "enable exchanging alive messages with netmcu"
    default y

  config RV_DEBUG
    bool "enable debug messages for rv"
    default n
endmenu
```

## stm32/rv/src/main/water_pump/Kconfig
```kconfig
menu "RV: Water Pump"

    config RV_WATER_PUMP_RELAY
        int  "relay number to switch water pump contactor (for turning on pump)"
        range 0 15
        default 15

    config RV_PRESS_CONTROL_RELAY
        int  "relay number to switch pressure-control contactor (for turning off PC)"
        range 0 15
        default 14



	config WP_RUST_PROTECTION_RUN_TIME
		int "seconds to run pump for rust protecion"
		default 2
		
	config WP_PC_CLEAR_FAILURE_TIME
		int "seconds to switch of mains voltage of pressure-control for error reset"
		default 5
		
	config WAPU_DEBUG
	   bool "turn on debbung of water_pump"
	   default n


endmenu
```
